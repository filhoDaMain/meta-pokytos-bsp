## conf/layer.conf
```bitbake
# meta-pokytos-bsp layer configuration file

# We have a conf and classes directory, add to BBPATH
BBPATH .= ":${LAYERDIR}"

# We have recipes-* directories, add to BBFILES
BBFILES += "${LAYERDIR}/recipes-*/*/*.bb \
            ${LAYERDIR}/recipes-*/*/*.bbappend"

BBFILE_COLLECTIONS += "meta-pokytos-bsp"
BBFILE_PATTERN_meta-pokytos-bsp = "^${LAYERDIR}/"
BBFILE_PRIORITY_meta-pokytos-bsp = "5"
LAYERSERIES_COMPAT_meta-pokytos-bsp = "nanbield"
```

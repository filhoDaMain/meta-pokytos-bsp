## conf/machine/include/raspi3ap.inc
```bitbake
# Based on 'raspberrypi3.conf' from meta-raspberrypi
DEFAULTTUNE ?= "cortexa7thf-neon-vfpv4"
require conf/machine/include/arm/armv7a/tune-cortexa7.inc
include conf/machine/include/rpi-base.inc

# "Act" as a raspberrypi3 for all other recipes which don't have explicit
# support for raspi3ap machine
MACHINEOVERRIDES:prepend = "raspberrypi3:"

PREFERRED_PROVIDER_virtual/kernel = "linux-stable"
PREFERRED_PROVIDER_virtual/bootloader = "u-boot"

unset MACHINE_EXTRA_RRECOMMENDS
unset IMAGE_BOOT_FILES
unset KERNEL_DEVICETREE
```

## conf/machine/opizero3.conf
```bitbake
require include/opizero3.inc

KERNEL_DTB_FILE = "sun50i-h618-orangepi-zero3.dtb"
KERNEL_DEVICETREE = "allwinner/${KERNEL_DTB_FILE}"
UBOOT_MACHINE = "orangepi_zero3_defconfig"
SPL_BINARY = "u-boot-sunxi-with-spl.bin"

# as for now neither graphics nor audio is supported
MACHINE_FEATURES:remove = "alsa x11"
MACHINE_FEATURES:append = "bluetooth wifi"
MACHINE_EXTRA_RRECOMMENDS = "uwe5622-firmware kernel-modules"

IMAGE_BOOT_FILES = "\
    ${KERNEL_IMAGETYPE} \
    boot.scr \
    ${KERNEL_DTB_FILE} \
"
```

## conf/machine/qemu-opizero3.conf
```bitbake
require include/opizero3.inc

UBOOT_MACHINE = "qemu_arm64_defconfig"
IMAGE_FSTYPES = "tar.bz2 ext4"


# QEMU
IMAGE_CLASSES += "qemuboot"
QB_SYSTEM_NAME = "qemu-system-aarch64"

# Generic arm64 emulation
QB_MACHINE = "-machine virt"
QB_CPU = "-cpu cortex-a53"
QB_SMP ?= "-smp 4"
QB_MEM = "-m 1024"
QB_CPU_KVM = "-cpu host -machine gic-version=3"

QB_ROOTFS_OPT = "\
    -drive if=none,file=@ROOTFS@,format=raw,id=mmc0 \
    -device virtio-blk-device,drive=mmc0 \
"

# Network
GDB_PORT_FWD = "tcp::1234-:1234"

QB_NETWORK_DEVICE = "\
    -device virtio-net-device,netdev=eth0,mac=@MAC@ \
"
QB_SLIRP_OPT = "\
    -netdev user,id=eth0,hostfwd=tcp::2222-:22,hostfwd=${GDB_PORT_FWD} \
"
```

## conf/machine/qemu-raspi3ap.conf
```bitbake
require include/raspi3ap.inc

UBOOT_MACHINE = "qemu_arm64_defconfig"
IMAGE_FSTYPES = "tar.bz2 ext4"


# QEMU
IMAGE_CLASSES += "qemuboot"
QB_SYSTEM_NAME = "qemu-system-aarch64"

# Generic arm64 emulation
QB_MACHINE = "-machine virt"
QB_CPU = "-cpu cortex-a7"
QB_SMP ?= "-smp 4"
QB_MEM = "-m 512"
#QB_CPU_KVM = "-cpu host -machine gic-version=3"

QB_ROOTFS_OPT = "\
    -drive if=none,file=@ROOTFS@,format=raw,id=mmc0 \
    -device virtio-blk-device,drive=mmc0 \
"

# Network
QB_NETWORK_DEVICE = "\
    -device virtio-net-device,netdev=eth0,mac=@MAC@ \
"
QB_SLIRP_OPT = "\
    -netdev user,id=eth0,hostfwd=tcp::2222-:22 \
"
```
